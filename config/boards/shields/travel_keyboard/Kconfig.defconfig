## config/boards/shields/travel_keyboard/Kconfig.defconfig
```kconfig
if SHIELD_TRAVEL_KEYBOARD

config ZMK_KEYBOARD_NAME
    default "LilKeeb"

config ZMK_SLEEP
    default y

config ZMK_PM_SOFT_OFF
    default y

endif
```

## config/boards/shields/travel_keyboard/Kconfig.shield
```kconfig
config SHIELD_TRAVEL_KEYBOARD
    def_bool $(shields_list_contains,travel_keyboard)
```
